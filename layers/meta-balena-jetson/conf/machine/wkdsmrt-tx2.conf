## layers/meta-balena-jetson/conf/machine/wkdsmrt-tx2.conf
```bitbake
#@TYPE: Machine
##@NAME: wkdsmrt-tx2
##@DESCRIPTION: Machine configuration for the WKDSMRT Tx2 Configuration

MACHINEOVERRIDES = "jetson-tx2:${MACHINE}"
ODMDATA ?= "0x90000"
include conf/machine/jetson-tx2.conf
```
